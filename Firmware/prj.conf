## CMakeLists.txt
```
# SPDX-License-Identifier: Apache-2.0

cmake_minimum_required(VERSION 3.20.0)
find_package(Zephyr REQUIRED HINTS $ENV{ZEPHYR_BASE})
project(fw)

target_sources(app PRIVATE src/Bluetooth.c src/Control.c src/Heartbeat.c src/Subject.c src/Ui.c src/main.c)
```

## prj.conf
```kconfig
CONFIG_BT=y
CONFIG_BT_PERIPHERAL=y
CONFIG_BT_DEVICE_NAME="CampChef:xx:xx"

CONFIG_GPIO=y
CONFIG_LOG=y
```

## src/main.c
```c
//==============================================================================
// Notes
//==============================================================================


//==============================================================================
// Includes
//==============================================================================
#include <zephyr/kernel.h>

#include "Bluetooth.h"
#include "Control.h"
#include "Heartbeat.h"
#include "Subject.h"
#include "Ui.h"

//==============================================================================
// Definitions
//==============================================================================


//==============================================================================
// Enumerations and Structures
//==============================================================================


//==============================================================================
// Private Function Prototypes
//==============================================================================


//==============================================================================
// Variables
//==============================================================================


//==============================================================================
// Main
//==============================================================================
int main() {
	Subject_Init();
	Bluetooth_Init();
	Control_Init();
	Heartbeat_Init();
	// Ui_Init();

	Subject_Start();
	Bluetooth_Start();
	Control_Start();
	Heartbeat_Start();
	// Ui_Start();
}

//==============================================================================
// Private Functions
//==============================================================================


//==============================================================================
// Task Handler
//==============================================================================


//==============================================================================
// Interrupt
//==============================================================================
```

## src/Bluetooth.c
```c
//==============================================================================
// Notes
//==============================================================================


//==============================================================================
// Includes
//==============================================================================
#include <zephyr/bluetooth/bluetooth.h>
#include <zephyr/bluetooth/gap.h>
#include <zephyr/kernel.h>
#include <zephyr/logging/log.h>

#include "Bluetooth.h"

//==============================================================================
// Definitions
//==============================================================================
LOG_MODULE_REGISTER(Bluetooth, LOG_LEVEL_INF);

#define DEVICE_NAME CONFIG_BT_DEVICE_NAME
#define DEVICE_NAME_LEN (sizeof(DEVICE_NAME) - 1)

//==============================================================================
// Enumerations and Structures
//==============================================================================


//==============================================================================
// Private Function Prototypes
//==============================================================================


//==============================================================================
// Variables
//==============================================================================
static const struct bt_le_adv_param _advertisingParameters[] = BT_LE_ADV_PARAM(
	(BT_LE_ADV_OPT_CONNECTABLE | BT_LE_ADV_OPT_USE_IDENTITY), /* Connectable advertising and use identity address */
	BT_GAP_ADV_FAST_INT_MIN_1, 		/* 0x30 units, 48 units, 30ms */
	BT_GAP_ADV_FAST_INT_MAX_1,		/* 0x60 units, 96 units, 60ms */
	NULL 							/* Set to NULL for undirected advertising */
); 

static const struct bt_data _advertiseData[] = {
	BT_DATA_BYTES(BT_DATA_FLAGS, BT_LE_AD_GENERAL | BT_LE_AD_NO_BREDR),
	BT_DATA(BT_DATA_NAME_COMPLETE, DEVICE_NAME, DEVICE_NAME_LEN),
};

static unsigned char url_data[] = { 0x17, '/', '/', 'w', 'w', 'w', '.', 'c', 'a',
	'm',  'p', 'c', 'h', 'e', 'f', '.', 'c', 'o', 'm' };

static const struct bt_data _scanResponseData[] = {
	BT_DATA(BT_DATA_URI, url_data, sizeof(url_data)),
};

//==============================================================================
// Public Functions
//==============================================================================
int Bluetooth_Init() {
	LOG_INF("Initializing");

	int err = bt_enable(NULL);
	if (err) {
		LOG_ERR("Bluetooth failed to init: %d\n", err);
		return err;
	}

	return 0;
}

int Bluetooth_Start() {
	LOG_INF("Starting");

	int err = bt_le_adv_start(_advertisingParameters, _advertiseData, ARRAY_SIZE(_advertiseData), _scanResponseData, ARRAY_SIZE(_scanResponseData));
	if (err) {
		LOG_ERR("Advertising failed to start (err %d)\n", err);
		return err;
	}

	LOG_INF("Advertising successfully started\n");

	return 0;
}

//==============================================================================
// Private Functions
//==============================================================================


//==============================================================================
// Task Handler
//==============================================================================


//==============================================================================
// Interrupt
//==============================================================================
```

## src/Bluetooth.h
```c
#ifndef BLUETOOTH_H_
#define BLUETOOTH_H_

//==============================================================================
// Notes
//==============================================================================


//==============================================================================
// Definitions
//==============================================================================


//==============================================================================
// Includes
//==============================================================================


//==============================================================================
// Enumerations and Structures
//==============================================================================


//==============================================================================
// Function Prototypes
//==============================================================================
int Bluetooth_Init();
int Bluetooth_Start();

//==============================================================================
// Variables
//==============================================================================


//==============================================================================
// Macro Functions
//==============================================================================


#endif /* Bluetooth.h */
```

## src/Control.c
```c
/*
 * Camp Chef
 * Copyright (C) 2024, All rights reserved.
 *
 * Control.c
 */

//==============================================================================
// Notes
//==============================================================================


//==============================================================================
// Includes
//==============================================================================
#include <zephyr/kernel.h>
#include <zephyr/logging/log.h>
#include <zephyr/devicetree.h>
#include <zephyr/drivers/gpio.h>

#include "Control.h"

//==============================================================================
// Definitions
//==============================================================================
LOG_MODULE_REGISTER(Control, LOG_LEVEL_INF);

#define BEAM_NODE				DT_NODELABEL(button0)
#define NEUTRAL_NODE			DT_NODELABEL(button1)
#define OIL_NODE				DT_NODELABEL(button2)
#define TURN_NODE				DT_NODELABEL(button3)

//==============================================================================
// Enumerations and Structures
//==============================================================================


//==============================================================================
// Private Function Prototypes
//==============================================================================
static void control_handler(void* args);

static void control_beamHandler(const struct device *dev, struct gpio_callback *cb, uint32_t pins);
static void control_neutralHandler(const struct device *dev, struct gpio_callback *cb, uint32_t pins);
static void control_oilHandler(const struct device *dev, struct gpio_callback *cb, uint32_t pins);
static void control_turnHandler(const struct device *dev, struct gpio_callback *cb, uint32_t pins);

//==============================================================================
// Variables
//==============================================================================
K_THREAD_DEFINE(_controlThread, 1024, control_handler, NULL, NULL, NULL, 4, 0, -1);

static const struct gpio_dt_spec beam = GPIO_DT_SPEC_GET(BEAM_NODE, gpios);
static const struct gpio_dt_spec neutral = GPIO_DT_SPEC_GET(NEUTRAL_NODE, gpios);
static const struct gpio_dt_spec oil = GPIO_DT_SPEC_GET(OIL_NODE, gpios);
static const struct gpio_dt_spec turn = GPIO_DT_SPEC_GET(TURN_NODE, gpios);

//==============================================================================
// Public Functions
//==============================================================================
int Control_Init() {
	LOG_INF("Initializing");

	static struct gpio_callback beamCBData;
	static struct gpio_callback neutralCBData;
	static struct gpio_callback oilCBData;
	static struct gpio_callback turnCBData;

	if (!device_is_ready(beam.port))
		return -1;
	else if (gpio_pin_configure_dt(&beam, GPIO_INPUT) < 0)
		return -1;
	else if (gpio_pin_interrupt_configure_dt(&beam, GPIO_INT_EDGE_TO_ACTIVE) < 0)
		return -1;
	gpio_init_callback(&beamCBData, control_beamHandler, BIT(beam.pin));
	gpio_add_callback(beam.port, &beamCBData);

	if (!device_is_ready(neutral.port))
		return -1;
	else if (gpio_pin_configure_dt(&neutral, GPIO_INPUT) < 0)
		return -1;
	else if (gpio_pin_interrupt_configure_dt(&neutral, GPIO_INT_EDGE_TO_ACTIVE) < 0)
		return -1;
	gpio_init_callback(&neutralCBData, control_neutralHandler, BIT(neutral.pin));
	gpio_add_callback(neutral.port, &neutralCBData);
	
	if (!device_is_ready(oil.port))
		return -1;
	else if (gpio_pin_configure_dt(&oil, GPIO_INPUT) < 0)
		return -1;
	else if (gpio_pin_interrupt_configure_dt(&oil, GPIO_INT_EDGE_TO_ACTIVE) < 0)
		return -1;
	gpio_init_callback(&oilCBData, control_oilHandler, BIT(oil.pin));
	gpio_add_callback(oil.port, &oilCBData);

	if (!device_is_ready(turn.port))
		return -1;
	else if (gpio_pin_configure_dt(&turn, GPIO_INPUT) < 0)
		return -1;
	else if (gpio_pin_interrupt_configure_dt(&turn, GPIO_INT_EDGE_TO_ACTIVE) < 0)
		return -1;
	gpio_init_callback(&turnCBData, control_turnHandler, BIT(turn.pin));
	gpio_add_callback(turn.port, &turnCBData);

	return 0;
}

int Control_Start() {
	LOG_INF("Starting");
	k_thread_start(_controlThread);
	return 0;
}

//==============================================================================
// Private Functions
//==============================================================================


//==============================================================================
// Task Handler
//==============================================================================
static void control_handler(void* args) {
	while(1) {
		k_msleep(1000);
	}
}

//==============================================================================
// Interrupt
//==============================================================================
static void control_beamHandler(const struct device *dev, struct gpio_callback *cb, uint32_t pins) {

}

static void control_neutralHandler(const struct device *dev, struct gpio_callback *cb, uint32_t pins) {

}

static void control_oilHandler(const struct device *dev, struct gpio_callback *cb, uint32_t pins) {

}

static void control_turnHandler(const struct device *dev, struct gpio_callback *cb, uint32_t pins) {
}
```

## src/Control.h
```c
/*
 * Camp Chef
 * Copyright (C) 2024, All rights reserved.
 * 
 * Control.h
 */

#ifndef CONTROL_H_
#define CONTROL_H_

//==============================================================================
// Notes
//==============================================================================


//==============================================================================
// Definitions
//==============================================================================


//==============================================================================
// Includes
//==============================================================================


//==============================================================================
// Enumerations and Structures
//==============================================================================


//==============================================================================
// Function Prototypes
//==============================================================================
int Control_Init();
int Control_Start();

//==============================================================================
// Variables
//==============================================================================


//==============================================================================
// Macro Functions
//==============================================================================


#endif /* Control.h */
```

## src/Heartbeat.c
```c
//==============================================================================
// Notes
//==============================================================================


//==============================================================================
// Includes
//==============================================================================
#include <zephyr/kernel.h>
#include <zephyr/device.h>
#include <zephyr/drivers/gpio.h>
#include <zephyr/logging/log.h>

#include "Heartbeat.h"

//==============================================================================
// Definitions
//==============================================================================
LOG_MODULE_REGISTER(Heartbeat, LOG_LEVEL_INF);

#define LED0_NODE DT_ALIAS(led0)

#define HEARTBEAT_BPM			70

//==============================================================================
// Enumerations and Structures
//==============================================================================
typedef struct HeartbeatState_t {
	int8_t State;
	int16_t Duration;
} HeartbeatState_t;

//==============================================================================
// Private Function Prototypes
//==============================================================================
static void heartbeat_handler(void* args);

//==============================================================================
// Variables
//==============================================================================
K_THREAD_DEFINE(_heartbeatThread, 1024, heartbeat_handler, NULL, NULL, NULL, 14, 0, -1);

static const struct gpio_dt_spec led0 = GPIO_DT_SPEC_GET_OR(LED0_NODE, gpios, {0});

static HeartbeatState_t _states[] = {
	{ .State = 0, .Duration = (HEARTBEAT_BPM * 1000 / 60) - 400 },
	{ .State = 1, .Duration = 75 },
	{ .State = 0, .Duration = 250 },
	{ .State = 1, .Duration = 75 },
};

//==============================================================================
// Public Functions
//==============================================================================
int Heartbeat_Init() {
	if (!gpio_is_ready_dt(&led0)) {
		LOG_ERR("GPIO is not ready!");
		return -1;
	}

	int ret = gpio_pin_configure_dt(&led0, GPIO_OUTPUT_ACTIVE);
	if (ret < 0) {
		LOG_ERR("Failed to configure GPIO pin!");
		return ret;
	}

	return 0;
}

int Heartbeat_Start() {
	k_thread_start(_heartbeatThread);
	return 0;
}

//==============================================================================
// Private Functions
//==============================================================================
static void heartbeat_handler(void* args) {
	static int8_t step = 0;

	while(1) {
		gpio_pin_set_dt(&led0, _states[step].State);
		k_msleep(_states[step].Duration);

		step++;
		if (step >= 4)
			step = 0;
	}
}

//==============================================================================
// Task Handler
//==============================================================================


//==============================================================================
// Interrupt
//==============================================================================
```

## src/Heartbeat.h
```c
#ifndef HEARTBEAT_H_
#define HEARTBEAT_H_

//==============================================================================
// Notes
//==============================================================================


//==============================================================================
// Definitions
//==============================================================================


//==============================================================================
// Includes
//==============================================================================


//==============================================================================
// Enumerations and Structures
//==============================================================================


//==============================================================================
// Function Prototypes
//==============================================================================
int Heartbeat_Init();
int Heartbeat_Start();

//==============================================================================
// Variables
//==============================================================================


//==============================================================================
// Macro Functions
//==============================================================================


#endif /* Heartbeat.h */
```

## src/Subject.c
```c
//==============================================================================
// Notes
//==============================================================================


//==============================================================================
// Includes
//==============================================================================
#include <zephyr/kernel.h>
#include <zephyr/logging/log.h>

#include "Subject.h"

//==============================================================================
// Definitions
//==============================================================================
LOG_MODULE_REGISTER(Subject, LOG_LEVEL_INF);

#define CHANGE_QUEUE_LENGTH				16
#define MSQ_QUEUE_PUT_TIMEOUT			K_MSEC(10)
//==============================================================================
// Enumerations and Structures
//==============================================================================


//==============================================================================
// Private Function Prototypes
//==============================================================================

static void subject_observerAdd(Observer_t* observer);
static int subject_observerExists(const Observer_t* this);
static void subject_observerNotify(ChangeFlag_t changeFlag);

static void subject_handler(void* args);

//==============================================================================
// Variables
//==============================================================================
K_THREAD_DEFINE(_subjectThread, 1024, subject_handler, NULL, NULL, NULL, 4, 0, -1);
K_MSGQ_DEFINE(_subjectChangeQueue, sizeof(ChangeFlag_t), CHANGE_QUEUE_LENGTH, sizeof(uint8_t));

static Observer_t* _first = NULL;

//==============================================================================
// Public Functions
//==============================================================================
int Subject_Init() {
	LOG_INF("Initializing");
	return 0;
}

int Subject_Start() {
	LOG_INF("Starting");
	k_thread_start(_subjectThread);
	return 0;
}

void Subject_ObserverSubscribe(Observer_t* observer) {
	if (subject_observerExists(observer))
		return;

	subject_observerAdd(observer);
}

//==============================================================================
// Private Functions
//==============================================================================
static void subject_observerAdd(Observer_t* newObserver) {
	if (subject_observerExists(newObserver))
		return;

	if (!_first) {
		_first = newObserver;
		newObserver->Next = NULL;
		return;
	}

	Observer_t* observer = _first;
	while(observer->Next) {
		observer = observer->Next;
	}

	observer->Next = newObserver;
	newObserver->Next = NULL;
	return;
}

static int subject_observerExists(const Observer_t* this) {
	for (Observer_t* observer = _first; observer; observer = observer->Next) {
		if (observer == this) {
			return 1;
		}
	}
	return 0;
}

static void subject_observerNotify(ChangeFlag_t changeFlag) {
	for (Observer_t* observer = _first; observer; observer = observer->Next) {
		if ((observer->Subscriptions & changeFlag) && (observer->Notify)) {
			observer->Notify(changeFlag);
		}
	}
}

//==============================================================================
// Task Handler
//==============================================================================
static void subject_handler(void* args) {
	ChangeFlag_t changeFlag;

	while(1) {
		// Wait for a new event to be pushed to the QUEUE
		if (k_msgq_get(&_subjectChangeQueue, &changeFlag, K_FOREVER) != 0)
			continue;

		subject_observerNotify(changeFlag);
	}
}

//==============================================================================
// Interrupt
//==============================================================================
```

## src/Subject.h
```c
#ifndef SUBJECT_H_
#define SUBJECT_H_

//==============================================================================
// Notes
//==============================================================================


//==============================================================================
// Definitions
//==============================================================================


//==============================================================================
// Includes
//==============================================================================


//==============================================================================
// Enumerations and Structures
//==============================================================================
typedef enum ChangeFlag_t {
	ChangeFlag_BatteryVoltage =			(1 << 0),
	ChangeFlag_Beam =					(1 << 1),
	ChangeFlag_Clock =					(1 << 2),
	ChangeFlag_CurrentSpeed =			(1 << 3),
	ChangeFlag_Distance =				(1 << 4),
	ChangeFlag_FuelLevel =				(1 << 5),
	ChangeFlag_Neutral =				(1 << 6),
	ChangeFlag_Oil =					(1 << 7),
	ChangeFlag_TimeElapsed =			(1 << 8),
	ChangeFlag_Turn_Left =				(1 << 9),
	ChangeFlag_Turn_Right =				(1 << 10),
	ChangeFlag_AllChanges =				0x3FF,
} ChangeFlag_t;

typedef void (*Notify_f)(ChangeFlag_t);

typedef struct Observer_t Observer_t;
struct Observer_t {
	uint16_t Subscriptions;
	Notify_f Notify;
	Observer_t* Next;
};

//==============================================================================
// Function Prototypes
//==============================================================================
int Subject_Init();
int Subject_Start();

// Macro helper functions
void Subject_ObserverSubscribe(Observer_t* observer);

//==============================================================================
// Variables
//==============================================================================


//==============================================================================
// Macro Functions
//==============================================================================
#define OBSERVER_CREATE_NEW(observer, subscriptions, notify) \
static Observer_t observer = Observer_t { \
	.Next = NULL, \
	.Subscriptions = subscriptions, \
	.Notify = notify, \
};

#define OBSERVER_SUBSCRIBE(observer, subscriptions, notify) \
OBSERVER_CREATE_NEW(observer, subscriptions, notify); \
Subject_ObserverSubscribe(&observer);

#endif /* Subject.h */
```

## src/UI.c
```c
/*
 * Camp Chef
 * Copyright (C) 2024, All rights reserved.
 *
 * Ui.c
 */

//==============================================================================
// Notes
//==============================================================================


//==============================================================================
// Includes
//==============================================================================
#include <zephyr/kernel.h>
#include <zephyr/logging/log.h>

#include "Ui.h"

//==============================================================================
// Definitions
//==============================================================================
LOG_MODULE_REGISTER(Ui, LOG_LEVEL_INF);

//==============================================================================
// Enumerations and Structures
//==============================================================================


//==============================================================================
// Private Function Prototypes
//==============================================================================
static void ui_handler(void* args);

//==============================================================================
// Variables
//==============================================================================
K_THREAD_DEFINE(_uiThread, 1024, ui_handler, NULL, NULL, NULL, 4, 0, -1);

//==============================================================================
// Public Functions
//==============================================================================
int Ui_Init() {
	LOG_INF("Initializing");
	return 0;
}

int Ui_Start() {
	LOG_INF("Starting");
	k_thread_start(_uiThread);
	return 0;
}

//==============================================================================
// Private Functions
//==============================================================================


//==============================================================================
// Task Handler
//==============================================================================
static void ui_handler(void* args) {

	while(1) {
		k_msleep(1000);
	}
}

//==============================================================================
// Interrupt
//==============================================================================
```

## src/Ui.c
```c
//==============================================================================
// Notes
//==============================================================================


//==============================================================================
// Includes
//==============================================================================
#include <zephyr/kernel.h>
#include <zephyr/logging/log.h>

#include "Ui.h"

//==============================================================================
// Definitions
//==============================================================================
LOG_MODULE_REGISTER(Ui, LOG_LEVEL_INF);

//==============================================================================
// Enumerations and Structures
//==============================================================================


//==============================================================================
// Private Function Prototypes
//==============================================================================
static void ui_handler(void* args);

//==============================================================================
// Variables
//==============================================================================
K_THREAD_DEFINE(_uiThread, 1024, ui_handler, NULL, NULL, NULL, 4, 0, -1);

//==============================================================================
// Public Functions
//==============================================================================
int Ui_Init() {
	LOG_INF("Initializing");
	return 0;
}

int Ui_Start() {
	LOG_INF("Starting");
	k_thread_start(_uiThread);
	return 0;
}

//==============================================================================
// Private Functions
//==============================================================================


//==============================================================================
// Task Handler
//==============================================================================
static void ui_handler(void* args) {
	while(1) {
		k_msleep(1000);
	}
}

//==============================================================================
// Interrupt
//==============================================================================
```

## src/Ui.h
```c
#ifndef UI_H_
#define UI_H_

//==============================================================================
// Notes
//==============================================================================


//==============================================================================
// Definitions
//==============================================================================


//==============================================================================
// Includes
//==============================================================================


//==============================================================================
// Enumerations and Structures
//==============================================================================


//==============================================================================
// Function Prototypes
//==============================================================================
int Ui_Init();
int Ui_Start();

//==============================================================================
// Variables
//==============================================================================


//==============================================================================
// Macro Functions
//==============================================================================


#endif /* Ui.h */
```
